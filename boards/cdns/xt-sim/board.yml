## boards/cdns/xt-sim/board.yml
```yaml
board:
  name: xt-sim
  full_name: Xtensa simulator
  vendor: cdns
  socs:
  - name: hifi5s_ao_7
```

## soc/cdns/dsp/Kconfig.defconfig
```kconfig
# Copyright (c) 2024 Cadence Design Systems, Inc.
# SPDX-License-Identifier: Apache-2.0

if SOC_XTENSA_DSP

config SOC_XTENSA_DSP
	select XTENSA_GEN_HANDLERS

endif
```

## soc/cdns/dsp/Kconfig.soc
```kconfig
# Copyright (c) 2024 Cadence Design Systems, Inc.
# SPDX-License-Identifier: Apache-2.0

config SOC_XTENSA_DSP
	bool

config SOC
	default "dsp" if SOC_XTENSA_DSP

config SOC_TOOLCHAIN_NAME
	string
	default "dsp" if SOC_XTENSA_DSP
```

## soc/cdns/xtensa_lx/Kconfig
```kconfig
# Copyright (c) 2024 Cadence Design Systems, Inc.
# SPDX-License-Identifier: Apache-2.0

config SOC_XTENSA_LX
	select XTENSA
	select XTENSA_HAL if ("$(ZEPHYR_TOOLCHAIN_VARIANT)" != "xcc" && "$(ZEPHYR_TOOLCHAIN_VARIANT)" != "xt-clang")
	select ARCH_SUPPORTS_COREDUMP
	select XTENSA_SMALL_VECTOR_TABLE_ENTRY
	select ATOMIC_OPERATIONS_BUILTIN
```

## soc/cdns/xtensa_lx/Kconfig.soc
```kconfig
# Copyright (c) 2024 Cadence Design Systems, Inc.
# SPDX-License-Identifier: Apache-2.0

config SOC_XTENSA_LX
	bool

config SOC
	default "xtensa_lx" if SOC_XTENSA_LX

config SOC_TOOLCHAIN_NAME
	string
	default "xtensa_lx" if SOC_XTENSA_LX
```
