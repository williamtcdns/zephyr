## soc/cdns/LX8_HiFi5_L2_Coh_2P/Kconfig
```kconfig
# Copyright (c) 2024 Cadence Design Systems, Inc.
# SPDX-License-Identifier: Apache-2.0

config SOC_XTENSA_LX8_HIFI5_L2_COH_2P
	select XTENSA
	select XTENSA_HAL if ("$(ZEPHYR_TOOLCHAIN_VARIANT)" != "xcc" && "$(ZEPHYR_TOOLCHAIN_VARIANT)" != "xt-clang")
	select ARCH_SUPPORTS_COREDUMP
```

## soc/cdns/LX8_HiFi5_L2_Coh_2P/Kconfig.defconfig
```kconfig
# Copyright (c) 2024 Cadence Design Systems, Inc.
# SPDX-License-Identifier: Apache-2.0

if SOC_XTENSA_LX8_HIFI5_L2_COH_2P

config SOC_XTENSA_LX8_HIFI5_L2_COH_2P
	select XTENSA_GEN_HANDLERS

endif
```

## soc/cdns/LX8_HiFi5_L2_Coh_2P/Kconfig.soc
```kconfig
# Copyright (c) 2024 Cadence Design Systems, Inc.
# SPDX-License-Identifier: Apache-2.0

config SOC_XTENSA_LX8_HIFI5_L2_COH_2P
	bool

config SOC
	default "LX8_HiFi5_L2_Coh_2P" if SOC_XTENSA_LX8_HIFI5_L2_COH_2P

config SOC_TOOLCHAIN_NAME
	string
	default "LX8_HiFi5_L2_Coh_2P" if SOC_XTENSA_LX8_HIFI5_L2_COH_2P
```

## soc/cdns/hifi5s_ao_7/Kconfig
```kconfig
# Copyright (c) 2024 Cadence Design Systems, Inc.
# SPDX-License-Identifier: Apache-2.0

config SOC_XTENSA_HIFI5S_AO_7
	select XTENSA
	select XTENSA_HAL if ("$(ZEPHYR_TOOLCHAIN_VARIANT)" != "xcc" && "$(ZEPHYR_TOOLCHAIN_VARIANT)" != "xt-clang")
	select ARCH_SUPPORTS_COREDUMP
```

## soc/cdns/hifi5s_ao_7/Kconfig.defconfig
```kconfig
# Copyright (c) 2024 Cadence Design Systems, Inc.
# SPDX-License-Identifier: Apache-2.0

if SOC_XTENSA_HIFI5S_AO_7

config SOC_XTENSA_HIFI5S_AO_7
	select XTENSA_GEN_HANDLERS

endif
```

## soc/cdns/hifi5s_ao_7/Kconfig.soc
```kconfig
# Copyright (c) 2024 Cadence Design Systems, Inc.
# SPDX-License-Identifier: Apache-2.0

config SOC_XTENSA_HIFI5S_AO_7
	bool

config SOC
	default "hifi5s_ao_7" if SOC_XTENSA_HIFI5S_AO_7

config SOC_TOOLCHAIN_NAME
	string
	default "hifi5s_ao_7" if SOC_XTENSA_HIFI5S_AO_7
```
